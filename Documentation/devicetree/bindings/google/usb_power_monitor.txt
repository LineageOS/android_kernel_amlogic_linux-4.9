## Documentation/devicetree/bindings/google/usb_power_monitor.txt
```
Google USB Power Monitor

Required properties:
 - compatible: "google,usb-power-monitor"

Optional properties:
 - bc_chg_det-gpio		gpio pin for BC 1.2 chg_det

 - typec_power_supply		typec power supply phandle, have to support get
				property of POWER_SUPPLY_PROP_ONLINE and
				POWER_SUPPLY_PROP_CURRENT_MAX.

 - #thermal-sensor-cells	export to thermal zone

Example:
	usb-power-monitor {
		compatible = "google,usb-power-monitor";
		bc_chg_det-gpio = <&gpio GPIOH_8 GPIO_ACTIVE_HIGH>;
		typec_power_supply = <&rt1711h>;
		#thermal-sensor-cells = <0>;
	};
```

## arch/arm64/configs/g12a_tab_variant_defconfig
```kconfig
CONFIG_INPUT_TOUCHSCREEN=y
CONFIG_TOUCHSCREEN_PROPERTIES=y
CONFIG_HID_MULTITOUCH=y
CONFIG_THERMAL_DEFAULT_GOV_POWER_ALLOCATOR=y
```

## arch/arm64/configs/sabrina_defconfig
```kconfig
CONFIG_GOOGLE_DRIVER=y
CONFIG_GOOGLE_USB_POWER_MONITOR=y
CONFIG_SENSORS_NTC_THERMISTOR=y
CONFIG_TYPEC=y
CONFIG_TYPEC_TCPM=y
CONFIG_TYPEC_RT1711H=y
CONFIG_TYPEC_FUSB302=y
CONFIG_THERMAL_DEFAULT_GOV_STEP_WISE=y
CONFIG_THERMAL_GOV_STEP_WISE=y
```

## drivers/google/Kconfig
```kconfig
menuconfig GOOGLE_DRIVER
	tristate "Google Drivers"
	default n
	help
	  Google Drivers

if GOOGLE_DRIVER

config GOOGLE_USB_POWER_MONITOR
	tristate "USB Power Monitor"
	depends on OF && HWMON && THERMAL && THERMAL_OF
	help
	  Sabrina USB power monitor

endif # GOOGLE_DRIVER
```

## drivers/usb/roles/Kconfig
```kconfig
config USB_ROLE_SWITCH
	tristate "USB Role Switch Support"
	help
	  USB Role Switch is a device that can select the USB role - host or
	  device - for a USB port (connector). In most cases dual-role capable
	  USB controller will also represent the switch, but on some platforms
	  multiplexer/demultiplexer switch is used to route the data lines on
	  the USB connector between separate USB host and device controllers.

	  Say Y here if your USB connectors support both device and host roles.
	  To compile the driver as module, choose M here: the module will be
	  called roles.ko.
```
